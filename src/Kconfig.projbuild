## src/Kconfig.projbuild
```kconfig
menu "User Configuration"

  menu "Wifi Configuration"
    comment "STA Mode Configuration"

    config ESP_WIFI_SSID
      string "Wifi SSID"
      default "network name"
      help
        SSID (network name) for STA to connect to.

    config ESP_WIFI_SSID_PASSWD
      string "Wifi SSID password"
      default "network name password"
      help
        Wifi SSID (network name) password (WPA or WPA2) for STA to connect.

    config ESP_MAXIMUM_RETRY
      int "Maximum retry"
      default 5
      help
        Set maximum retry value to prevent the station to continuously
        attempting to reconnect to the access point (AP) when the AP doesn't
        exist.

    choice ESP_WIFI_SAE_MODE
      prompt "WPA3 SAE mode selection"
      default ESP_WPA3_SAE_PWE_BOTH
      help
        Select mode for SAE as Hunt and Peck, H2E or both.

      config ESP_WPA3_SAE_PWE_HUNT_AND_PECK
        bool "HUNT AND PECK"
      config ESP_WPA3_SAE_PWE_HASH_TO_ELEMENT
        bool "H2E"
      config ESP_WPA3_SAE_PWE_BOTH
        bool "BOTH"
    endchoice

    config ESP_WIFI_PW_ID
      string "PASSWORD IDENTIFIER"
      depends on ESP_WPA3_SAE_PWE_HASH_TO_ELEMENT || ESP_WPA3_SAE_PWE_BOTH
      default ""
      help
        password identifier for SAE H2E

    choice ESP_WIFI_SCAN_AUTH_MODE_THRESHOLD
      prompt "Wifi scan auth mode threshold"
      default ESP_WIFI_AUTH_WPA2_PSK
      help
        The weakest authmode to accept in the scan mode. This value defaults
        to ESP_WIFI_AUTH_WPA2_PSK in case password is present and
        ESP_WIFI_AUTH_OPEN is used. Please select
        ESP_WIFI_AUTH_WEP / ESP_WIFI_AUTH_WPA_PSK in case AP is operating in
        WEP / WPA mode.

      config ESP_WIFI_AUTH_OPEN
        bool "OPEN"
      config ESP_WIFI_AUTH_WEP
        bool "WEP"
      config ESP_WIFI_AUTH_WPA_PSK
        bool "WPA PSK"
      config ESP_WIFI_AUTH_WPA2_PSK
        bool "WPA2 PSK"
      config ESP_WIFI_AUTH_WPA_WPA2_PSK
        bool "WPA/WPA2 PSK"
      config ESP_WIFI_AUTH_WPA3_PSK
        bool "WPA3 PSK"
      config ESP_WIFI_AUTH_WPA2_WPA3_PSK
        bool "WPA2/WPA3 PSK"
      config ESP_WIFI_AUTH_WAPI_PSK
        bool "WAPI PSK"
    endchoice

  endmenu

  menu "ESP MQTT Configuration"
    comment "MQTT Configuration"

    config MQTT_BROKER_URL
      string "Broker URL"
      default "mqtt://10.10.10.1"
      help
        URL of the broker to connect.

    config MQTT_BROKER_PORT
      int "MQTT Port"
      default 1883
      help
        Port of the MQTT to connect.

    config MQTT_AUTH_USERNAME
      string "MQTT authentication Username"
      default "alien"
      help
        Username authentication for MQTT broker.

    config MQTT_AUTH_PASSWD
      string "MQTT authentication Password"
      default "auth_password"
      help
        Password authentication for MQTT broker.

  endmenu
endmenu
```
